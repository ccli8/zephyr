## boards/nuvoton/numaker_m3351ki/numaker_m3351ki_m335xxx_ns_defconfig
```kconfig
# SPDX-License-Identifier: Apache-2.0

# TrustZone
CONFIG_TRUSTED_EXECUTION_NONSECURE=y

# TF-M
CONFIG_BUILD_WITH_TFM=y
CONFIG_TFM_PROFILE_TYPE_MEDIUM=y
CONFIG_TFM_ISOLATION_LEVEL=1
CONFIG_TFM_SFN=y
CONFIG_TFM_PARTITION_PLATFORM=y
CONFIG_TFM_PARTITION_CRYPTO=y
CONFIG_TFM_PARTITION_PROTECTED_STORAGE=y
CONFIG_TFM_PARTITION_FIRMWARE_UPDATE=y
CONFIG_TFM_PARTITION_PROTECTED_STORAGE=y
CONFIG_TFM_PARTITION_FIRMWARE_UPDATE=y
CONFIG_TFM_BL2=y
CONFIG_TFM_MCUBOOT_IMAGE_NUMBER=2
CONFIG_TFM_MCUBOOT_SIGNATURE_TYPE="EC-P256"
CONFIG_TFM_PUBLIC_KEY_FORMAT_HASH=y
CONFIG_TFM_BL2_LOG_LEVEL_INFO=y

CONFIG_GPIO=y

# Enable system clock controller driver
CONFIG_CLOCK_CONTROL=y
CONFIG_CLOCK_CONTROL_NUMAKER_SCC=y

# Enable UART driver
CONFIG_SERIAL=y
CONFIG_UART_INTERRUPT_DRIVEN=y

# Console
CONFIG_CONSOLE=y
CONFIG_UART_CONSOLE=y
```

## dts/bindings/clock/nuvoton,numaker-scc.yaml
```yaml
# Copyright (c) 2023 Nuvoton Technology Corporation
# SPDX-License-Identifier: Apache-2.0

description: Nuvoton NuMaker System Clock Controller (SCC)

compatible: "nuvoton,numaker-scc"

include: [clock-controller.yaml, base.yaml]

properties:
  reg:
    required: true

  hxt:
    type: string
    description: |
      Enable/disable 4~24 MHz external crystal oscillator (HXT)
    enum:
      - "untouched"
      - "enable"
      - "disable"

  lxt:
    type: string
    description: |
      Enable/disable 32.768 kHz low-speed external crystal oscillator (LXT)
    enum:
      - "untouched"
      - "enable"
      - "disable"

  hirc48:
    type: string
    description: |
      Enable/disable 48 MHz high-speed internal RC oscillator (HIRC48)
    enum:
      - "untouched"
      - "enable"
      - "disable"

  clk-pclkdiv:
    type: int
    description: |
      Configure APB Clock Divider register

  core-clock:
    type: int
    description: |
      Configure core clock (HCLK)

  pll-clock-source:
    type: int
    description: |
      Configure PLL clock source. Same as u32PllFreq parameter on invoking
      BSP CLK driver CLK_EnablePLL().

  pll-target-frequency:
    type: int
    description: |
      Configure PLL target frequency. Same as u32PllFreq parameter on invoking
      BSP CLK driver CLK_EnablePLL().

  hclk-clock-source:
    type: int
    description: |
      Configure HCLK clock source. Same as u32ClkSrc parameter on invoking
      BSP CLK driver CLK_SetHCLK().

  hclk-clock-divider:
    type: int
    description: |
      Configure HCLK clock divider. Same as u32ClkDiv parameter on invoking
      BSP CLK driver CLK_SetHCLK().
```

## dts/bindings/spi/nuvoton,numaker-spi.yaml
```yaml
# Copyright (c) 2023 Nuvoton Technology Corporation.
# SPDX-License-Identifier: Apache-2.0

description: Nuvoton, NuMaker SPI controller

compatible: "nuvoton,numaker-spi"

include: [spi-controller.yaml, reset-device.yaml, pinctrl-device.yaml]

properties:
  reg:
    required: true

  interrupts:
    required: true

  resets:
    required: true

  clocks:
    required: true

  qspi:
    type: boolean
    description: |
      Identifies as QSPI peripheral which can run in Standard (1-bit) mode
```

## samples/drivers/spi_flash/boards/numaker_pfm_m467.conf
```kconfig
# SPDX-FileCopyrightText: Copyright (c) 2026 Nuvoton Technology Corporation
# SPDX-License-Identifier: Apache-2.0

CONFIG_GPIO=y
CONFIG_LOG=y
CONFIG_FLASH_LOG_LEVEL_INF=y
```

## samples/net/mqtt_publisher/Kconfig
```kconfig
# Config options for mqtt_publisher sample application

# Copyright (c) 2020 Intel Corporation
# SPDX-License-Identifier: Apache-2.0

mainmenu "Networking mqtt_publisher sample application"

config NET_SAMPLE_APP_MAX_ITERATIONS
	int "Number of times to Publish sample MQTT messages"
	default 500
	help
	  Send sample MQTT messages this many times in a MQTT connection
	  before exiting. A value of zero means that the messages are sent
	  forever.

config NET_SAMPLE_APP_MAX_CONNECTIONS
	int "Number of times to connect to the MQTT server"
	default 0
	help
	  Number of times to connect to the MQTT server. With each connection
	  send NET_SAMPLE_APP_MAX_ITERATIONS amount of MQTT sample messages.
	  A value of zero means to continue forever.

config NET_SAMPLE_APP_MQTT_BROKER_ECLIPSEPROJECTS
	bool "Use MQTT broker mqtt.eclipseprojects.io"
	default y if SOC_FAMILY_NUMAKER
	help
	  Choose mqtt.eclipseprojects.io as MQTT broker

source "Kconfig.zephyr"
```

## tests/drivers/can/api/boards/numaker_m2l31ki.conf
```kconfig
# SPDX-FileCopyrightText: Copyright (c) 2026 Nuvoton Technology Corporation
# SPDX-License-Identifier: Apache-2.0

CONFIG_TEST_USERSPACE=n
```
